/* Copyright (c) 2019, The Linux Foundation. All rights reserved.
 *
 * This program is free software; you can redistribute it and/or modify
 * it under the terms of the GNU General Public License version 2 and
 * only version 2 as published by the Free Software Foundation.
 *
 * This program is distributed in the hope that it will be useful,
 * but WITHOUT ANY WARRANTY; without even the implied warranty of
 * MERCHANTABILITY or FITNESS FOR A PARTICULAR PURPOSE.  See the
 * GNU General Public License for more details.
 */

/dts-v1/;

<<<<<<<< HEAD:arch/arm64/boot/dts/qcom/trinket-sofia-base.dts
#include "trinket-moto-base.dtsi"

&firmware {
	/delete-node/ android;
};

&pmi632_rgb {
	/delete-node/ blue;
	/delete-node/ green;
};

&tlmm {
	/delete-node/ nfc;
};
========
#include "sdxprairie-cdp-v1.1-cpe.dtsi"

/ {
	model = "Qualcomm Technologies, Inc. SDXPRAIRIE CDP (CPE-1.1)";
	compatible = "qcom,sdxprairie-cdp",
		"qcom,sdxprairie", "qcom,cdp";
	qcom,board-id = <0x5010101 0x0>;
};


>>>>>>>> local/kernel.lnx.4.14.r27-rel:arch/arm64/boot/dts/qcom/sdxprairie-cdp-v1.1-cpe.dts
