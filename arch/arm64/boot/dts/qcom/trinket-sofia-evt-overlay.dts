/* Copyright (c) 2010,2017,2019, The Linux Foundation. All rights reserved.
 *
 * This program is free software; you can redistribute it and/or modify
 * it under the terms of the GNU General Public License version 2 and
 * only version 2 as published by the Free Software Foundation.
 *
 * This program is distributed in the hope that it will be useful,
 * but WITHOUT ANY WARRANTY; without even the implied warranty of
 * MERCHANTABILITY or FITNESS FOR A PARTICULAR PURPOSE.  See the
 * GNU General Public License for more details.
<<<<<<<< HEAD:arch/arm64/boot/dts/qcom/trinket-sofia-evt-overlay.dts
 */

/dts-v1/;
/plugin/;

#include <dt-bindings/clock/qcom,gcc-trinket.h>
#include "trinket-sofia-common-overlay.dtsi"

/ {
	model = "sofia";
	compatible = "qcom,trinket-sofia", "qcom,trinket-moto", "qcom,trinket";
	qcom,msm-id = <394 0x0>;
	qcom,board-id = <0x46 0xA200>;
};

&cci {
	qcom,eeprom@3 {
		qcom,cci-master = <0>;
	};

	qcom,camera@3 {
		qcom,cci-master = <0>;
	};
};
========
 *
 */
#ifndef __LINUX_MSM_SMD_PKT_H
#define __LINUX_MSM_SMD_PKT_H

#include <linux/ioctl.h>

#define SMD_PKT_IOCTL_MAGIC (0xC2)

#define SMD_PKT_IOCTL_BLOCKING_WRITE \
	_IOR(SMD_PKT_IOCTL_MAGIC, 0, unsigned int)

#endif /* __LINUX_MSM_SMD_PKT_H */
>>>>>>>> local/kernel.lnx.4.14.r27-rel:include/linux/msm_smd_pkt.h
